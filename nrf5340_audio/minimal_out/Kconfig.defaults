## nrf5340_audio/minimal_out/Kconfig.defaults
```kconfig
config MINIMAL_OUT
bool "Minimal Out"
	default y

  ## ISO related configs ##
config BT_ISO_PERIPHERAL
	default y

config BT_ISO_MAX_CHAN
	default 2
```
